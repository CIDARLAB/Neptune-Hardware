/*           Initalize with buttons     
 *              Add on before easy demo code
 *              -Zach Lasiuk
 *                
 *                
 *                What does it do:
 *                    INITALIZATION:
 *                      -Asks user to turn servo in small increments with button to find absolute ends
 *                      -Asks user to note two places where mL is obvious
 *                    NORMAL CODE
 *                      -moves servos on shield pins 0-3 to a specified degree (1-180)
 *                      -blinks LED on pin 53 to show the 1 second timmer is uninterupted by serial communication and internal processing
 *                
 *                How to run code:
 *                    -Need Arduino Mega 2560 with servo motor shield attached
 *                    -Plug in servos (should be FiTec FS5106B) to pins 0-3 of Arduino shield
 *                      -To use another servo, calibrate SERVOMIN and SERVOMAX to be the PWM values to make the servo horn 0 and 180 degrees respectivly
 *                    -Plug in buttons to pins 50 and 52, to GND
 *                    -Upload script
 *                    -Open Serial Monitor
 *                        INITALIZE:
 *                          -Follow instructions on Serial Monitor
 *                        NORMAL CODE:
 *                          -Type in number in degrees you want the servo horn to rotate to, eg. 102
 * 
 * 
 * 
 *                Library functions:     
 *                    setPWMFreq(freq)
 *                      -Adjusts PWM frequency which determines how many full 'pulses' per second are generated by the IC.
 *                       -Must be between 40-1000 (in Hz)
 *                       -Check servo to see if number violates speed at which servo can read pulses
 *        
 *                    setPWM(channel, on, off)
 *                        channel:    The channel that should be updated with the new values (0..15)
 *                        on:         The tick (between 0..4095) when the signal should transition from low to high
 *                        off:        The tick (between 0..4095) when the signal should transition from high to low
 *                        
 * 
 *                 Notes while working:             
 *                    Equation-->    mL = A/2[1-cos(θ)] + mL0
 *          
 */

      
/////////////////////     Import Libraries as needed      /////////////////////
#include <avr/interrupt.h>              // interupts
#include <avr/io.h>                     // interupts
#include <Wire.h>                       // motor control shield, needed for I2C
#include <Adafruit_PWMServoDriver.h>    // import motor control shield library


/////////////////////     Initalize Servo Motor Shield      /////////////////////

// called this way, it uses the default address 0x40
// you can also call it with a different address you want --> Adafruit_PWMServoDriver pwm = Adafruit_PWMServoDriver(0x41);
Adafruit_PWMServoDriver pwm = Adafruit_PWMServoDriver();

int SERVOMIN = 180;              // this is the 'minimum' pulse length count (out of 4096)
int SERVOMAX = 540;              // this is the 'minimum' pulse length count (out of 4096)
float user_value_in = 0;           // used to store all user inputs that are integers or floats
int pulselength = 0;             // length that PWM signal is on for
float angle = 0;                 //calculated angle from formula


const int up_button = A15;
const int down_button = 51;
int up = 0;             // variable for reading up_button pin status
int down = 0;           // variable for reading down_button pin status
int last_up = 0;
int last_down = 0;
boolean button_change = false;


float A = 0;
float mL0 = 0;
float mL1 = 0;      // needed to calculate A, temporary variable that isn't used in formula once A is found

boolean initalized = false;      // statment to run initalization code until complete
boolean instructions_complete = false;
boolean MIN_init = false;
boolean MAX_init = false;
boolean mL0_init = false;
boolean mL1_init = false;
boolean calculations = false;


uint8_t servo_num = 0;           // our servo # counter

String inputString = "";         // a string to hold incoming data
boolean stringComplete = false;  // whether the string is complete

unsigned int toggle = 0;  //used to keep the state of the LED
unsigned int count = 0;   //used to keep count of how many interrupts were fired



/////////////////////     Timer2 Function      /////////////////////

//Timer2 Overflow Interrupt Vector, called every 1ms
ISR(TIMER2_OVF_vect) {
  count++;               //Increments the interrupt counter
  if(count > 999){
    toggle = !toggle;    //toggles the LED state
    count = 0;           //Resets the interrupt counter
  }
  digitalWrite(53,toggle);
  TCNT2 = 130;           //Reset Timer to 130 out of 255
  TIFR2 = 0x00;          //Timer2 INT Flag Reg: Clear Timer Overflow Flag
};  


/////////////////////     Setup Function      /////////////////////

void setup() {
  // blink an LED for error checking
  pinMode(53,OUTPUT);

  // setup buttons for initalization proceedure, pull-ups enabled
  pinMode(up_button,INPUT_PULLUP);
  pinMode(down_button,INPUT_PULLUP);
  
  // initialize serial communication
  Serial.begin(9600);
  inputString.reserve(200);   // reserve 200 bytes for the inputString

  // Initalize PWM for motor control shield
  pwm.begin(); 
  pwm.setPWMFreq(60);  // Analog servos run at ~60 Hz updates
  yield();
  
  //Setup Timer2 to fire every 1ms
  TCCR2B = 0x00;        //Disbale Timer2 while we set it up
  TCNT2  = 130;         //Reset Timer Count to 130 out of 255 
  TIFR2  = 0x00;        //Timer2 INT Flag Reg: Clear Timer Overflow Flag
  TIMSK2 = 0x01;        //Timer2 INT Reg: Timer2 Overflow Interrupt Enable
  TCCR2A = 0x00;        //Timer2 Control Reg A: Normal port operation, Wave Gen Mode normal
  TCCR2B = 0x05;        //Timer2 Control Reg B: Timer Prescaler set to 128


  // Print initalize statement
  Serial.println("Hello! Welcome to ServoServer, where servos serve spectacularly specific solutions via syringes.");
  Serial.println("To test you understand our input system, please enter 'Hi!' to proceed");
}


/////////////////////     Looped Function      /////////////////////

void loop() { 
  if (!initalized) {

    // This code block detects if a button push occcured
    up = digitalRead(up_button);
    down = digitalRead(down_button);
    if (up != last_up) { 
      if (up == 0) button_change = true;
    }
    if (down != last_down) { 
      if (down == 0) button_change = true;
    }   
    last_up = up;
    last_down = down;

   
    if (stringComplete || button_change) {
      inputString.trim();  //removes new line character to make comparing string easier
      
      if(!instructions_complete) {
        if (inputString=="Hi!") {
          instructions_complete = true;
          Serial.println("");
          Serial.println("Nice! Now lets initalize the servo.");
          Serial.println("We need to find the point where the servo horn (where our mechanical system hooks up to the servo) is at 0 and 180 degrees");
          Serial.println("These end ranges corrospond to when the syringe is pushed all the way out (0degrees) and pulled all the way in (180degrees)");
          Serial.println("Lets find when the servo is pushed out first.");
          Serial.println("Press the button to go up or down and I'll tell you the current PWM value you are on.");
          Serial.println("IMPORTANT: Do not make the servo rotate past its designed rotation range. Move slowly and adjust the horn by taking it off if neccecary.");
          Serial.println("Once the horn is at 0 degrees and the syringe is pushed all the way out enter 'good'.");
          Serial.println("Push buttons now:");
        }
        else Serial.println("Looks like you didn't enter the correct line. Try entering 'Hi!' again");
      }      

      else if(!MIN_init) {
        if (inputString=="good") {
          SERVOMIN = user_value_in;
          MIN_init = true;
          Serial.println("");
          Serial.print("Your new SERVOMIN value is: "); Serial.println(SERVOMIN);
          Serial.println("Enter the current mL value on syringe");
          Serial.println("Once entered in, type 'good' to proceed");
        }
        else {
          user_value_in = inputString.toInt();
          Serial.println(user_value_in);
          pwm.setPWM(0,0,user_value_in);
        }
      }

      else if(!mL0_init) {
          user_value_in = inputString.toFloat();
          mL0 = user_value_in;
          mL0_init = true;
          Serial.println("");
          Serial.print("Your mL0 value is "); Serial.println(mL0);
          Serial.println("Now lets find the where the servo is at 180 degrees, where the syringe is pulled all the way in.");
          Serial.println("Once syringe is pulled all the way in (horn is at 180 degrees) enter 'good' to proceed.");
          Serial.println("Push buttons now:");
      }
      
      else if(!MAX_init) {
        if (inputString=="good") {
          SERVOMAX = user_value_in;
          MAX_init = true;
          Serial.println("");
          Serial.print("Great, your new SERVOMAX  value is: "); Serial.println(SERVOMAX);
          Serial.println("Enter the current mL value on syringe");
          Serial.println("Once entered in, type 'good' to proceed");
        }
        else {
          user_value_in = inputString.toInt();
          Serial.println(user_value_in);
          pwm.setPWM(0,0,user_value_in);
        }
      }
     
      else if(!mL1_init) {
          user_value_in = inputString.toFloat();
          mL1 = user_value_in;
          mL1_init = true;
          Serial.println("");
          Serial.print("Your mL1 value is "); Serial.println(mL1);
          Serial.println("Your syringe is being initalized. Hit any key to initalize syringe");
      }

      else if(!calculations) {

        A = mL1-mL0;
        //angle = acos(1-(2*[mL-mL0]/A))
        
        Serial.print("A equals: "); Serial.println(A);
        Serial.print("mL = ("); Serial.print(A); Serial.print("/2)*[1-cos(angle)]+"); Serial.println(mL0);
        Serial.print("angle = acos(1-(2[mL-"); Serial.print(mL0); Serial.print("]/"); Serial.print(A); Serial.println("))");
        Serial.println("Your syringe is finished being initalized! Feel free to use by entering in desired goal mL values");
        calculations = true;
        initalized = true;
      }
      
      // clear the string and button state change variables:
      inputString = "";
      stringComplete = false;
      button_change = false;
    }
  }

  // if initalized, proceed with main code
  else {  
    if (stringComplete) {
  
        user_value_in = inputString.toFloat();

        angle = acos(1-((2*(user_value_in-mL0))/A));
        angle = angle*180/PI;
        Serial.println(angle);
        
        pulselength = map(angle, 0, 180, SERVOMIN, SERVOMAX); 
        pwm.setPWM(0,0,pulselength);
        pwm.setPWM(1,0,pulselength);
        pwm.setPWM(2,0,pulselength);
        pwm.setPWM(3,0,pulselength);     
        
        // clear the string:
        inputString = "";
        stringComplete = false;
      
    }
  }  
}


/////////////////////     Read Serial Function      /////////////////////
/*
  SerialEvent occurs whenever a new data comes in the
 hardware serial RX.  This routine is run between each
 time loop() runs, so using delay inside loop can delay
 response.  Multiple bytes of data may be available.
 */
void serialEvent() {
  while (Serial.available()) {
    // get the new byte:
    char inChar = (char)Serial.read();
    // add it to the inputString:
    inputString += inChar;
    // if the incoming character is a newline, set a flag
    // so the main loop can do something about it:
    if (inChar == '\n') {
      stringComplete = true;
    }
  }
}
